## conf/layer.conf
```bitbake
# We have a conf and classes directory, append to BBPATH
BBPATH .= ":${LAYERDIR}"

# We have a recipes directory, add to BBFILES
BBFILES += "${LAYERDIR}/recipes-*/*/*.bb ${LAYERDIR}/recipes-*/*/*.bbappend"

BBFILE_COLLECTIONS += "linh-layer"
BBFILE_PATTERN_linh-layer := "^${LAYERDIR}/"
BBFILE_PRIORITY_linh-layer = "8"

LAYERDEPENDS_linh-layer = "core openembedded-layer freescale-layer"
LAYERSERIES_COMPAT_linh-layer = "rocko sumo thud warrior"
```
